## conf/bblayers.conf
```bitbake
# POKY_BBLAYERS_CONF_VERSION is increased each time build/conf/bblayers.conf
# changes incompatibly
POKY_BBLAYERS_CONF_VERSION = "2"

BBPATH = "${TOPDIR}"
BBFILES ?= ""

BBLAYERS ?= " \
  /media/mihail/terabyte/yocto/poky/meta \
  /media/mihail/terabyte/yocto/poky/meta-poky \
  /media/mihail/terabyte/yocto/poky/meta-yocto-bsp \
  /media/mihail/terabyte/yocto/meta-openembedded/meta-oe \
  /media/mihail/terabyte/yocto/meta-openembedded/meta-python \
  /media/mihail/terabyte/yocto/meta-openembedded/meta-multimedia \
  /media/mihail/terabyte/yocto/meta-openembedded/meta-networking \
  /media/mihail/terabyte/yocto/meta-openembedded/meta-gnome \
  /media/mihail/terabyte/yocto/meta-openembedded/meta-xfce \
  /media/mihail/terabyte/yocto/meta-raspberrypi \
  "
```
